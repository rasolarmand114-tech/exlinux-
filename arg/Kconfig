## arg/Kconfig
```kconfig
# SPDX-License-Identifier: GPL-2.0
# arg/Kconfig

config SCHED_ARG_KMM
	tristate "ARG Scheduler Module (Rust + ARM64 Assembly)"
	depends on SCHED_ARG
	depends on SMP
	depends on ARM64
	default m
	help
	  ARG Scheduler Layer — ۹۵٪ منطق پروژه.

	  پیاده‌سازی شده در Rust + ARM64 Assembly:
	    - Task Packing        (صرفه‌جویی انرژی)
	    - Async / Gaming mode (arg_async=1)
	    - Sync / Throughput   (arg_async=0)
	    - FPS Stability       (arg_fps=1)
	    - Energy-Aware        (arg_energy=1)
	    - Virtual Thread Layer
	    - CPU Hotplug + big.LITTLE
	    - ARM64 feature detection (LSE/FP/SVE/AES/SHA)
```

## kernel/sched/Kconfig
```kconfig
# SPDX-License-Identifier: GPL-2.0

config SCHED_ARG
	bool "ARG Scheduler Hook Infrastructure"
	depends on SMP
	depends on ARM64 || COMPILE_TEST
	default n
	help
	  Lightweight hook layer for the ARG (Advanced Resource Governor)
	  scheduler module. Contains zero scheduling policy.

	  Inserts 5 hook points in CFS core path:
	    enqueue_task, ttwu_do_activate, pick_next_task,
	    calc_global_load_tick, enqueue_task_rt.

	  Each hook adds 1 load-acquire + 1 predictable branch when
	  the ARG module is not loaded. Required by CONFIG_SCHED_ARG_KMM.
	  If unsure, say N.

config SCHED_MC
```
